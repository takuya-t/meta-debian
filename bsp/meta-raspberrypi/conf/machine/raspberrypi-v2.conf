## bsp/meta-raspberrypi/conf/machine/raspberrypi-v2.conf
```bitbake
#@TYPE: Machine
#@NAME: RaspberryPi version 2 Model B
#@DESCRIPTION: Machine configuration for the RaspberryPi version 2 Model B
# SoC: Broadcom BCM2836
# CPU: Cortex A7

# enable hardware floating point (hf)
DEFAULTTUNE ?= "cortexa7hf"
require conf/machine/include/tune-cortexa7.inc

IMAGE_FSTYPES ?= "tar.bz2 ext3"

SERIAL_CONSOLE = "115200 ttyAMA0"

LINUX_DEFCONFIG ?= "bcm2836_defconfig"
LINUX_CONFIG_APPEND ?= "${MACHINE}.config"
KERNEL_DEVICETREE ?= "bcm2836-rpi-b.dtb"
```
